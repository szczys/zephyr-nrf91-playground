## CMakeLists.txt
```
# SPDX-License-Identifier: Apache-2.0

cmake_minimum_required(VERSION 3.20.0)
find_package(Zephyr REQUIRED HINTS $ENV{ZEPHYR_BASE})
project(blinky)

target_sources(app PRIVATE src/main.c)
target_sources(app PRIVATE src/golioth_app.c)
```

## prj.conf
```kconfig
CONFIG_GPIO=y
CONFIG_LOG=y
CONFIG_SHELL=y
CONFIG_SPI=y

CONFIG_GOLIOTH_SAMPLES_COMMON=y

# Generic networking options
CONFIG_NETWORKING=y
CONFIG_NET_IPV4=y
CONFIG_NET_IPV6=n

# Logging
CONFIG_NET_LOG=y
CONFIG_LOG_PROCESS_THREAD_STACK_SIZE=2048

# Network Shell
CONFIG_NET_SHELL=y

# TLS configuration
CONFIG_MBEDTLS_ENABLE_HEAP=y
CONFIG_MBEDTLS_HEAP_SIZE=10240
CONFIG_MBEDTLS_SSL_MAX_CONTENT_LEN=2048

# Application
CONFIG_MAIN_STACK_SIZE=4096

CONFIG_GOLIOTH=y
CONFIG_GOLIOTH_FW=y
CONFIG_GOLIOTH_SYSTEM_CLIENT=y

CONFIG_MINIMAL_LIBC_MALLOC_ARENA_SIZE=256

CONFIG_LOG_BACKEND_GOLIOTH=y
CONFIG_LOG_PROCESS_THREAD_STACK_SIZE=2048

CONFIG_FLASH=y
CONFIG_FLASH_MAP=y
CONFIG_NVS=y

CONFIG_SETTINGS=y
CONFIG_SETTINGS_RUNTIME=y
CONFIG_GOLIOTH_SAMPLE_SETTINGS_AUTOLOAD=y
CONFIG_GOLIOTH_SAMPLE_SETTINGS_SHELL=y

CONFIG_SYSTEM_WORKQUEUE_STACK_SIZE=4096
CONFIG_GOLIOTH_SETTINGS=y
```

## boards/sparkfun_thing_plus_nrf9160_ns.conf
```kconfig
# General config
CONFIG_HEAP_MEM_POOL_SIZE=4096
CONFIG_NEWLIB_LIBC=y

# Networking
CONFIG_NET_NATIVE=n
CONFIG_NET_SOCKETS_OFFLOAD=y

# Use Zephyr mbedTLS, as there was no success so far with using offloaded TLS in
# modem library.
CONFIG_NET_SOCKETS_OFFLOAD_TLS=n

# Increase native TLS socket implementation, so that it is chosen instead of
# offloaded nRF91 sockets
CONFIG_NET_SOCKETS_TLS_PRIORITY=35

# LTE link control
CONFIG_LTE_LINK_CONTROL=y
CONFIG_LTE_AUTO_INIT_AND_CONNECT=y

# Modem library
CONFIG_NRF_MODEM_LIB=y

# Offloaded poll() does not support external events like eventfd, so use timeout
# in poll() instead.
CONFIG_GOLIOTH_SYSTEM_CLIENT_TIMEOUT_USING_POLL=y

# Conflicts with MBEDTLS_DTLS
CONFIG_BUILD_WITH_TFM=n
```

## src/main.c
```c
/*
 * Copyright (c) 2016 Intel Corporation
 *
 * SPDX-License-Identifier: Apache-2.0
 */

#include <zephyr/zephyr.h>
#include <zephyr/drivers/gpio.h>
#include <zephyr/logging/log.h>
#include <stdbool.h>
LOG_MODULE_REGISTER(basic_spi, LOG_LEVEL_DBG);

#include "golioth_app.h"

#define SPI_OP	SPI_OP_MODE_MASTER | SPI_MODE_CPOL | SPI_MODE_CPHA | SPI_WORD_SET(8) | SPI_LINES_SINGLE

/* 1000 msec = 1 sec */
#define SLEEP_TIME_MS   1000

/* The devicetree node identifier for the "led0" alias. */
#define LED0_NODE DT_ALIAS(led0)

/* https://stackoverflow.com/a/69152884 */
#include <drivers/gpio.h>
#include <drivers/spi.h>

/*
 * Validate data received from MCP3201
 */
int validate_adc_data(uint8_t buf_data[4], uint16_t *adc_validated) {
	if (buf_data[0] & 1<<5) { return -ENOTSUP; }	/* Missing NULL bit */
	uint16_t data_msb = 0;
	uint16_t data_lsb = 0;
	data_msb = buf_data[0] & 0x1F;
	data_msb |= (data_msb<<7) | (buf_data[1]>>1);
	for (uint8_t i=0; i<12; i++) {
		bool bit_set = false;
		if (i < 2) {
			if (buf_data[1] & (1<<(1-i))) { bit_set = true; }
		}
		else if (i < 10) {
			if (buf_data[2] & (1<<(2+7-i))) { bit_set = true; }
		}
		else {
			if (buf_data[3] & (1<<(10+7-i))) { bit_set = true; }
		}

		if (bit_set) { data_lsb |= (1<<i); }
	}

					/* d[1].1 d[1].0 d[2].7 d[2].6 ... d[3].7 */
	if (data_msb != data_lsb) {
		LOG_DBG("data_msb=0x%04x data_lsb=0x%04x", data_msb, data_lsb);
		return -ENOTSUP;
	}
	
	*adc_validated = data_msb;	
	return 0;
}

/*
 * A build error on this line means your board is unsupported.
 * See the sample documentation for information on how to fix this.
 */
static const struct gpio_dt_spec led = GPIO_DT_SPEC_GET(LED0_NODE, gpios);

void main(void)
{
	LOG_INF("Started SPI demo");
	int ret;

	golioth_app_init();

	if (!device_is_ready(led.port)) {
		return;
	}

	ret = gpio_pin_configure_dt(&led, GPIO_OUTPUT_ACTIVE);
	if (ret < 0) {
		return;
	}
	const struct spi_dt_spec mcp3201_dev =
		SPI_DT_SPEC_GET(DT_NODELABEL(mcp3201), SPI_OP, 0);

	LOG_INF("spi_cs.bus = %p", mcp3201_dev.bus);
	LOG_INF("spi_cs.config.cs->gpio.port = %p", mcp3201_dev.config.cs->gpio.port);
	LOG_INF("spi_cs.config.cs->gpio.pin = %u", mcp3201_dev.config.cs->gpio.pin);
	
	uint8_t my_buffer[4] = {0};
	struct spi_buf my_spi_buffer[1];
	my_spi_buffer[0].buf = my_buffer;
	my_spi_buffer[0].len = 4;
	const struct spi_buf_set rx_buff = { my_spi_buffer, 1 };
	uint16_t valid_adc_data = 0;

	while (1) {
		ret = spi_read_dt(&mcp3201_dev, &rx_buff);
		if (ret) { LOG_INF("spi_read status: %d", ret); }
		LOG_INF("Received 4 bytes: %d %d %d %d",
					my_buffer[0],my_buffer[1],my_buffer[2], my_buffer[3]
					);
		ret = validate_adc_data(my_buffer, &valid_adc_data);
		if (ret == 0) { LOG_INF("Got ADC value: 0x%04x", valid_adc_data); }
		char sbuf[32] = {0};
		snprintk(sbuf, sizeof(sbuf), "{\"adc\":%d}", valid_adc_data);
		send_queued_data_to_golioth(sbuf, "sensor");

		ret = gpio_pin_toggle_dt(&led);
		if (ret < 0) {
			return;
		}
		k_msleep(SLEEP_TIME_MS);
	}
}
```

## src/golioth_app.c
```c
/*
 * Copyright (c) 2021 Golioth, Inc.
 *
 * SPDX-License-Identifier: Apache-2.0
 */


#include <logging/log.h>
LOG_MODULE_REGISTER(golioth_c, LOG_LEVEL_DBG);

#include <net/golioth/system_client.h>
#include <net/golioth/fw.h>

// #include "golioth_ota.h"
#include "golioth_app.h"

struct golioth_client *client = GOLIOTH_SYSTEM_CLIENT_GET();

struct coap_reply coap_replies[4]; // TODO: Refactor to remove coap_reply global variable


extern char current_version_str[sizeof("255.255.65535")];	//TODO: refactor to remove link to flash.c
extern enum golioth_dfu_result dfu_initial_result; //TODO: refactor to remove link to golioth_ota.c



K_MSGQ_DEFINE(sensor_data_msgq, SENSOR_DATA_STRING_LEN, SENSOR_DATA_ARRAY_SIZE, 4);




static void golioth_on_connect(struct golioth_client *client)
{
	struct coap_reply *reply;
	int i;

#ifdef __GOLIOTH_OTA_H__
	int err;
	err = golioth_fw_report_state(client, "main",
				      current_version_str,
				      NULL,
				      GOLIOTH_FW_STATE_IDLE,
				      dfu_initial_result);
	if (err) {
		LOG_ERR("Failed to report firmware state: %d", err);
	}
#endif

	for (i = 0; i < ARRAY_SIZE(coap_replies); i++) {
		coap_reply_clear(&coap_replies[i]);
	}

	reply = coap_reply_next_unused(coap_replies, ARRAY_SIZE(coap_replies));
	if (!reply) {
		LOG_ERR("No more reply handlers");
	}
#ifdef __GOLIOTH_OTA_H__
	err = golioth_fw_observe_desired(client, reply, golioth_desired_update);
	if (err) {
		coap_reply_clear(reply);
	}
#endif
}

static void golioth_on_message(struct golioth_client *client,
			       struct coap_packet *rx)
{
	uint16_t payload_len;
	const uint8_t *payload;
	uint8_t type;

	type = coap_header_get_type(rx);
	payload = coap_packet_get_payload(rx, &payload_len);

	(void)coap_response_received(rx, NULL, coap_replies,
				     ARRAY_SIZE(coap_replies));
}

void golioth_lightdb_stream_handler(struct k_work *work) 

{
	int err;
	char stream_data[SENSOR_DATA_STRING_LEN];

	LOG_DBG("Pulling data off of queue");
	err = k_msgq_get(&sensor_data_msgq, &stream_data, K_NO_WAIT);
	if (err)
	{
		LOG_DBG("Error getting data from the queue: %d\n", err);	
	}

	err = golioth_lightdb_set(client,
					  GOLIOTH_LIGHTDB_STREAM_PATH("sensor"),
					  COAP_CONTENT_FORMAT_TEXT_PLAIN,
					  stream_data, 
					  strlen(stream_data));
	if (err) {
		LOG_WRN("Failed to send sensor: %d", err);
		printk("Failed to send sensor: %d\n", err);	
	}

	LOG_DBG("Sent the following to LightDB Stream: %s\n", log_strdup(stream_data));

}

K_WORK_DEFINE(lightdb_stream_submit_worker, golioth_lightdb_stream_handler);


void send_queued_data_to_golioth(char* sensor_data_array, char* golioth_endpoint)
{
	int err;
	err = k_msgq_put(&sensor_data_msgq, sensor_data_array, K_NO_WAIT);
	if (err){
		LOG_ERR("Queue is full");
	}
	LOG_DBG("Kicking off LightDB Stream worker");
	k_work_submit(&lightdb_stream_submit_worker);

}

void golioth_app_init(void)
{
	client->on_connect = golioth_on_connect;
	client->on_message = golioth_on_message;
	golioth_system_client_start();
}
```

## src/golioth_app.h
```c
/*
 * Copyright (c) 2021 Golioth, Inc.
 *
 * SPDX-License-Identifier: Apache-2.0
 */

#ifndef __GOLIOTH_APP_H__
#define __GOLIOTH_APP_H__


extern struct golioth_client *client;

/* SENSOR_DATA_STRING_LEN must be a multiple of 4!! */
#define SENSOR_DATA_STRING_LEN	256
#define SENSOR_DATA_ARRAY_SIZE	16


#define GOLIOTH_STREAM_DEFAULT_ENDPOINT GOLIOTH_LIGHTDB_STREAM_PATH("sensor")

//prototype

void golioth_app_init(void);
void send_queued_data_to_golioth(char*, char*);

#endif
```
